## boards/shields/forager/Kconfig.defconfig
```kconfig
if SHIELD_FORAGER_LEFT

config ZMK_KEYBOARD_NAME
    default "Forager"

config ZMK_SPLIT_ROLE_CENTRAL
    default y

config ZMK_STUDIO
    default y

config ZMK_HID_CONSUMER_REPORT_USAGES_BASIC
    default y

config BT_CTLR_TX_PWR_PLUS_8
    default y

endif

if SHIELD_FORAGER_LEFT || SHIELD_FORAGER_RIGHT

config ZMK_SPLIT
    default y

endif
```
